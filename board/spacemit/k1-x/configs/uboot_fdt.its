## board/spacemit/k1-x/configs/uboot_fdt.its
```
/dts-v1/;

/ {
	description = "U-boot FIT image for k1x";
	#address-cells = <2>;
	fit,fdt-list = "of-list";

	images {
		uboot {
			description = "U-Boot";
			type = "standalone";
			os = "U-Boot";
			arch = "riscv";
			compression = "none";
			load = <0x0 0x00200000>;
			data = /incbin/("../u-boot-nodtb.bin");
		};

		fdt_1 {
			description = "k1_evb";
			type = "flat_dt";
			compression = "none";
			data = /incbin/("../dtb/k1-x_evb.dtb");
		};
		fdt_2 {
			description = "k1_deb1";
			type = "flat_dt";
			compression = "none";
			data = /incbin/("../dtb/k1-x_deb1.dtb");
		};
		fdt_3 {
			description = "k1_deb2";
			type = "flat_dt";
			compression = "none";
			data = /incbin/("../dtb/k1-x_deb2.dtb");
		};
	};

	configurations {
		default = "conf_1";
		conf_1 {
			description = "k1_evb";
			loadables = "uboot";
			fdt = "fdt_1";
		};
		conf_2 {
			description = "k1_deb1";
			loadables = "uboot";
			fdt = "fdt_2";
		};
		conf_3 {
			description = "k1_deb2";
			loadables = "uboot";
			fdt = "fdt_3";
		};
	};
};
```

## board/spacemit/k2/Kconfig
```kconfig
if TARGET_SPACEMIT_K2

config SYS_BOARD
	default "k2"

config SYS_VENDOR
	default "spacemit"

config SYS_CPU
	default "x100"

config SYS_CONFIG_NAME
	default "spacemit_k2"

config SYS_TEXT_BASE
	default 0x81200000 if SPL
	default 0x80000000 if !RISCV_SMODE
	default 0x80200000 if RISCV_SMODE

config SPL_TEXT_BASE
	default 0x20100000

config SPL_OPENSBI_LOAD_ADDR
	hex
	default 0x21000000

config SPACEMIT_BUILD_BIN
       bool "build fsbl.bin for spacemit image"
       default n

config BOARD_SPECIFIC_OPTIONS # dummy
	def_bool y
	select SPACEMIT_X100

choice
	prompt "product board"
	default K2_BOARD_FPGA

config K2_BOARD_FPGA
	bool "k2 board fpga"
	help
	  k2 board is fpga.

endchoice

endif
```

## board/spacemit/k2/configs/uboot_fdt.its
```
/dts-v1/;

/ {
	description = "U-boot FIT image for k2";
	#address-cells = <2>;
	fit,fdt-list = "of-list";

	images {
		uboot {
			description = "U-Boot";
			type = "standalone";
			os = "U-Boot";
			arch = "riscv";
			compression = "none";
			load = <0x0 0x00200000>;
			data = /incbin/("../u-boot-nodtb.bin");
			hash-1 {
				algo = "crc32";
			};
		};

		fdt_1 {
			description = "k2_fpga.dtb";
			type = "flat_dt";
			compression = "none";
			data = /incbin/("../dtb/k2_fpga.dtb");
			hash-1 {
				algo = "crc32";
			};
		};

	};

	configurations {
		default = "conf_1";
		conf_1 {
			description = "k2_fpga";
			loadables = "uboot";
			fdt = "fdt_1";
		};

	};
};
```

## board/spacemit/k3/configs/uboot_fdt.its
```
/dts-v1/;
/ {
	description = "U-boot FIT image for k3";
	#address-cells = <2>;
	fit,fdt-list = "of-list";

	images {
		uboot {
			description = "U-Boot";
			type = "standalone";
			os = "u-boot";
			arch = "riscv";
			compression = "none";
			load = <0x1 0x02000000>;
			data = /incbin/("../u-boot-nodtb.bin");
			hash-1 {
				algo = "crc32";
			};
		};

		fdt_1 {
			description = "k3_fpga.dtb";
			type = "flat_dt";
			compression = "none";
			data = /incbin/("../dtb/k3_fpga_1x1.dtb");
			hash-1 {
				algo = "crc32";
			};
		};

		fdt_2 {
			description = "k3_evb.dtb";
			type = "flat_dt";
			compression = "none";
			data = /incbin/("../dtb/k3_evb.dtb");
			hash-1 {
				algo = "crc32";
			};
		};

		fdt_3 {
			description = "k3_deb1.dtb";
			type = "flat_dt";
			compression = "none";
			data = /incbin/("../dtb/k3_deb1.dtb");
			hash-1 {
				algo = "crc32";
			};
		};

		fdt_4 {
			description = "k3_com260.dtb";
			type = "flat_dt";
			compression = "none";
			data = /incbin/("../dtb/k3_com260.dtb");
			hash-1 {
				algo = "crc32";
			};
		};

		fdt_5 {
			description = "k3_dc_board.dtb";
			type = "flat_dt";
			compression = "none";
			data = /incbin/("../dtb/k3_dc_board.dtb");
			hash-1 {
				algo = "crc32";
			};
		};

		fdt_6 {
			description = "k3_com260_kit_v02.dtb";
			type = "flat_dt";
			compression = "none";
			data = /incbin/("../dtb/k3_com260_kit_v02.dtb");
			hash-1 {
				algo = "crc32";
			};
		};

		fdt_7 {
			description = "k3_gemini_c0.dtb";
			type = "flat_dt";
			compression = "none";
			data = /incbin/("../dtb/k3_gemini_c0.dtb");
			hash-1 {
				algo = "crc32";
			};
		};

		fdt_8 {
			description = "k3_gemini_c1.dtb";
			type = "flat_dt";
			compression = "none";
			data = /incbin/("../dtb/k3_gemini_c1.dtb");
			hash-1 {
				algo = "crc32";
			};
		};
	};

	configurations {
		default = "conf_1";
		conf_1 {
			description = "k3_fpga";
			loadables = "uboot";
			fdt = "fdt_1";
		};

		conf_2 {
			description = "k3_evb";
			loadables = "uboot";
			fdt = "fdt_2";
		};

		conf_3 {
			description = "k3_deb1";
			loadables = "uboot";
			fdt = "fdt_3";
		};

		conf_4 {
			description = "k3_com260";
			loadables = "uboot";
			fdt = "fdt_4";
		};

		conf_5 {
			description = "k3_dc_board";
			loadables = "uboot";
			fdt = "fdt_5";
		};

		conf_6 {
			description = "k3_com260_kit_v02";
			loadables = "uboot";
			fdt = "fdt_6";
		};

		conf_7 {
			description = "k3_gemini_c0";
			loadables = "uboot";
			fdt = "fdt_7";
		};

		conf_8 {
			description = "k3_gemini_c1";
			loadables = "uboot";
			fdt = "fdt_8";
		};
	};
};
```

## board/spacemit/k3/configs/uboot_fdt_sign.its
```
/dts-v1/;
/ {
	description = "Signed U-boot FIT image for k3";
	#address-cells = <2>;
	fit,fdt-list = "of-list";

	images {
		uboot {
			description = "U-Boot";
			type = "standalone";
			os = "u-boot";
			arch = "riscv";
			compression = "none";
			load = <0x1 0x02000000>;
			data = /incbin/("../u-boot-nodtb.bin");
			hash {
				algo = "sha256";
			};
		};
		fdt_1 {
			description = "k3_fpga_1x1";
			type = "flat_dt";
			compression = "none";
			data = /incbin/("../dtb/k3_fpga_1x1.dtb");
			hash {
				algo = "sha256";
			};
		};
		fdt_3 {
			description = "k3_deb1.dtb";
			type = "flat_dt";
			compression = "none";
			data = /incbin/("../dtb/k3_deb1.dtb");
			hash {
				algo = "sha256";
			};
		};
		fdt_11 {
			description = "k3-pico-itx.dtb";
			type = "flat_dt";
			compression = "none";
			data = /incbin/("../dtb/k3-pico-itx.dtb");
			hash {
				algo = "sha256";
			};
		};
	};
	configurations {
		default = "conf_1";
		conf_1 {
			description = "k3_fpga";
			loadables = "uboot";
			fdt = "fdt_1";
			signature {
				algo = "sha256,rsa2048";
				key-name-hint = "uboot_key_prv";
				sign-images = "loadables", "fdt";
			};
		};
		conf_3 {
			description = "k3_deb1";
			loadables = "uboot";
			fdt = "fdt_3";
			signature {
				algo = "sha256,rsa2048";
				key-name-hint = "uboot_key_prv";
				sign-images = "loadables", "fdt";
			};
		};
		conf_11 {
			description = "k3-pico-itx";
			loadables = "uboot";
			fdt = "fdt_11";
			signature {
				algo = "sha256,rsa2048";
				key-name-hint = "uboot_key_prv";
				sign-images = "loadables", "fdt";
			};
		};
	};
};
```

## configs/k1-pro_fpga_defconfig
```kconfig
CONFIG_RISCV=y
CONFIG_SYS_TEXT_BASE=0xa000200000
CONFIG_SYS_MALLOC_LEN=0x800000
CONFIG_NR_DRAM_BANKS=1
CONFIG_ENV_SIZE=0x20000
CONFIG_DEFAULT_DEVICE_TREE="k1-pro_fpga"
CONFIG_SPL_SIZE_LIMIT=0x10000
CONFIG_SPL=y
CONFIG_SYS_LOAD_ADDR=0xa000200000
CONFIG_BUILD_TARGET=""
CONFIG_TARGET_SPACEMIT_K1PRO=y
CONFIG_SPL_OPENSBI_LOAD_ADDR=0xA000020000
CONFIG_K1_PRO_BOARD_FPGA=y
CONFIG_ARCH_RV64I=y
CONFIG_RISCV_SMODE=y
CONFIG_LOCALVERSION="spacemit"
CONFIG_HAS_CUSTOM_SYS_INIT_SP_ADDR=y
CONFIG_CUSTOM_SYS_INIT_SP_ADDR=0xa000800000
CONFIG_FIT=y
# CONFIG_BOOTSTD_BOOTCOMMAND is not set
CONFIG_SUPPORT_RAW_INITRD=y
CONFIG_BOOTDELAY=0
CONFIG_AUTOBOOT_KEYED=y
CONFIG_AUTOBOOT_STOP_STR="s"
CONFIG_USE_BOOTCOMMAND=y
CONFIG_BOOTCOMMAND="dhcp"
CONFIG_DISPLAY_CPUINFO=y
CONFIG_DISPLAY_BOARDINFO=y
CONFIG_SPL_MAX_SIZE=0x10000
CONFIG_SPL_BSS_START_ADDR=0x20010000
CONFIG_SPL_BSS_MAX_SIZE=0x1000
CONFIG_HUSH_PARSER=y
CONFIG_SYS_CBSIZE=256
CONFIG_SYS_PBSIZE=276
# CONFIG_CMD_CPU is not set
CONFIG_SYS_BOOTM_LEN=0x4000000
CONFIG_CMD_MMC=y
CONFIG_CMD_BKOPS_ENABLE=y
CONFIG_CMD_MMC_SWRITE=y
CONFIG_CMD_MTD=y
CONFIG_CMD_PART=y
CONFIG_CMD_USB=y
CONFIG_CMD_DHCP=y
CONFIG_SYS_DISABLE_AUTOLOAD=y
CONFIG_CMD_PXE=y
CONFIG_CMD_SYSBOOT=y
# CONFIG_OF_OMIT_DTB is not set
CONFIG_PROT_UDP=y
CONFIG_NET_RANDOM_ETHADDR=y
CONFIG_IP_DEFRAG=y
CONFIG_KEEP_SERVERADDR=y
CONFIG_BOOTP_SERVERIP=y
CONFIG_USB_FUNCTION_FASTBOOT=y
CONFIG_FASTBOOT_BUF_ADDR=0xA000070000
CONFIG_MISC=y
# CONFIG_SPL_MISC is not set
CONFIG_MMC=y
CONFIG_MMC_SDHCI=y
CONFIG_MMC_SDHCI_SPACEMIT=y
CONFIG_DM_MTD=y
# CONFIG_MTD_NOR_FLASH is not set
CONFIG_SYS_MAX_FLASH_BANKS=2
CONFIG_PHY_MARVELL=y
# CONFIG_E1000 is not set
CONFIG_ETH_DESIGNWARE=y
CONFIG_DW_ALTDESCRIPTOR=y
CONFIG_RMII=y
CONFIG_TIMER_EARLY=y
CONFIG_USB=y
CONFIG_DM_USB_GADGET=y
CONFIG_USB_XHCI_HCD=y
CONFIG_USB_XHCI_DWC3=y
CONFIG_USB_DWC3=y
CONFIG_USB_DWC3_GENERIC=y
CONFIG_USB_STORAGE=y
CONFIG_USB_GADGET=y
CONFIG_USB_GADGET_VENDOR_NUM=0x18D1
CONFIG_USB_GADGET_PRODUCT_NUM=0x0001
```

## configs/k1-x_evb_defconfig
```kconfig
CONFIG_RISCV=y
CONFIG_SYS_TEXT_BASE=0x00300000
CONFIG_SYS_MALLOC_LEN=0x800000
CONFIG_NR_DRAM_BANKS=1
CONFIG_ENV_SIZE=0x20000
CONFIG_DEFAULT_DEVICE_TREE="k1-x_fpga"
CONFIG_SPL_TEXT_BASE=0xC0800000
CONFIG_SPL_SIZE_LIMIT=0x10000
CONFIG_SPL=y
CONFIG_SYS_LOAD_ADDR=0x20200000
CONFIG_BUILD_TARGET=""
# CONFIG_AHCI is not set
CONFIG_TARGET_SPACEMIT_K1X=y
CONFIG_SPL_OPENSBI_LOAD_ADDR=0x00100000
CONFIG_K1_X_BOARD_ASIC=y
CONFIG_ARCH_RV64I=y
CONFIG_RISCV_SMODE=y
CONFIG_LOCALVERSION="spacemit"
CONFIG_ENV_VARS_UBOOT_CONFIG=y
CONFIG_HAS_CUSTOM_SYS_INIT_SP_ADDR=y
CONFIG_CUSTOM_SYS_INIT_SP_ADDR=0x21000000
CONFIG_STACK_SIZE=0x100000
CONFIG_FIT=y
# CONFIG_FIT_FULL_CHECK is not set
# CONFIG_FIT_PRINT is not set
CONFIG_SPL_LOAD_FIT_ADDRESS=0x10000000
# CONFIG_BOOTSTD is not set
# CONFIG_LEGACY_IMAGE_FORMAT is not set
CONFIG_SUPPORT_RAW_INITRD=y
CONFIG_BOOTDELAY=0
CONFIG_AUTOBOOT_KEYED=y
CONFIG_AUTOBOOT_STOP_STR="s"
CONFIG_USE_BOOTCOMMAND=y
CONFIG_BOOTCOMMAND="bootm 0x40000000"
CONFIG_DISPLAY_CPUINFO=y
CONFIG_DISPLAY_BOARDINFO=y
CONFIG_SPL_MAX_SIZE=0x20000
CONFIG_SPL_PAD_TO=0x0
CONFIG_SPL_BSS_START_ADDR=0xC0810000
CONFIG_SPL_BSS_MAX_SIZE=0x8000
# CONFIG_SPL_SHARES_INIT_SP_ADDR is not set
CONFIG_SPL_STACK=0xc0820000
CONFIG_SYS_SPL_MALLOC=y
CONFIG_HAS_CUSTOM_SPL_MALLOC_START=y
CONFIG_CUSTOM_SYS_SPL_MALLOC_ADDR=0x24000000
CONFIG_SYS_SPL_MALLOC_SIZE=0x400000
CONFIG_SPL_OPENSBI_SCRATCH_OPTIONS=0x0
CONFIG_HUSH_PARSER=y
CONFIG_SYS_CBSIZE=256
CONFIG_SYS_PBSIZE=276
# CONFIG_CMD_CPU is not set
CONFIG_SYS_BOOTM_LEN=0xa000000
CONFIG_CMD_MMC=y
CONFIG_CMD_PART=y
# CONFIG_CMD_SCSI is not set
CONFIG_CMD_DHCP=y
CONFIG_SYS_DISABLE_AUTOLOAD=y
CONFIG_CMD_PXE=y
CONFIG_CMD_SYSBOOT=y
# CONFIG_OF_OMIT_DTB is not set
CONFIG_PROT_UDP=y
CONFIG_NET_RANDOM_ETHADDR=y
CONFIG_IP_DEFRAG=y
CONFIG_KEEP_SERVERADDR=y
CONFIG_BOOTP_SERVERIP=y
CONFIG_DEVRES=y
# CONFIG_SCSI_AHCI is not set
# CONFIG_CLK is not set
CONFIG_DMA=y
CONFIG_DMA_CHANNELS=y
CONFIG_USB_FUNCTION_FASTBOOT=y
CONFIG_FASTBOOT_BUF_ADDR=0x40000000
# CONFIG_GPIO is not set
# CONFIG_I2C is not set
# CONFIG_INPUT is not set
CONFIG_MISC=y
CONFIG_MMC=y
# CONFIG_MMC_HW_PARTITIONING is not set
# CONFIG_MMC_VERBOSE is not set
CONFIG_MMC_SDHCI=y
CONFIG_MMC_SDHCI_ADMA=y
CONFIG_MMC_SDHCI_K1X=y
# CONFIG_MTD is not set
# CONFIG_MTD_NOR_FLASH is not set
CONFIG_SPACEMIT_K1X_EMAC=y
CONFIG_NVME_PCI=y
CONFIG_PCIE_DW_K1X=y
CONFIG_PINCTRL=y
CONFIG_PINCTRL_SINGLE=y
CONFIG_RESET_SPACEMIT_K1X=y
# CONFIG_SCSI is not set
# CONFIG_DM_SCSI is not set
CONFIG_SYS_NS16550_IER=0x40
# CONFIG_HTIF_CONSOLE is not set
# CONFIG_SIFIVE_SERIAL is not set
CONFIG_TIMER_EARLY=y
CONFIG_USB=y
# CONFIG_SPL_DM_USB is not set
CONFIG_USB_GADGET=y
CONFIG_USB_GADGET_VENDOR_NUM=0x361C
CONFIG_USB_GADGET_PRODUCT_NUM=0x0001
CONFIG_USB2_K1X_CI=y
```

## configs/k1-x_fpga_defconfig
```kconfig
CONFIG_RISCV=y
CONFIG_SYS_TEXT_BASE=0x00300000
CONFIG_SYS_MALLOC_LEN=0x800000
CONFIG_NR_DRAM_BANKS=1
CONFIG_ENV_SIZE=0x20000
CONFIG_DEFAULT_DEVICE_TREE="k1-x_fpga"
CONFIG_SPL_TEXT_BASE=0xC0800000
CONFIG_SPL_SIZE_LIMIT=0x10000
CONFIG_SPL=y
CONFIG_SYS_LOAD_ADDR=0x20200000
CONFIG_BUILD_TARGET=""
# CONFIG_AHCI is not set
CONFIG_TARGET_SPACEMIT_K1X=y
CONFIG_SPL_OPENSBI_LOAD_ADDR=0x00100000
CONFIG_ARCH_RV64I=y
CONFIG_RISCV_SMODE=y
CONFIG_LOCALVERSION="spacemit"
CONFIG_ENV_VARS_UBOOT_CONFIG=y
CONFIG_HAS_CUSTOM_SYS_INIT_SP_ADDR=y
CONFIG_CUSTOM_SYS_INIT_SP_ADDR=0x21000000
CONFIG_STACK_SIZE=0x100000
CONFIG_FIT=y
# CONFIG_FIT_FULL_CHECK is not set
# CONFIG_FIT_PRINT is not set
CONFIG_SPL_LOAD_FIT_ADDRESS=0x10000000
# CONFIG_BOOTSTD is not set
# CONFIG_LEGACY_IMAGE_FORMAT is not set
CONFIG_SUPPORT_RAW_INITRD=y
CONFIG_BOOTDELAY=0
CONFIG_AUTOBOOT_KEYED=y
CONFIG_AUTOBOOT_STOP_STR="s"
CONFIG_USE_BOOTCOMMAND=y
CONFIG_BOOTCOMMAND="bootm 0x40000000"
CONFIG_DISPLAY_CPUINFO=y
CONFIG_DISPLAY_BOARDINFO=y
CONFIG_SPL_MAX_SIZE=0x20000
CONFIG_SPL_PAD_TO=0x0
CONFIG_SPL_BSS_START_ADDR=0xC0810000
CONFIG_SPL_BSS_MAX_SIZE=0x8000
# CONFIG_SPL_SHARES_INIT_SP_ADDR is not set
CONFIG_SPL_STACK=0xc0820000
CONFIG_SYS_SPL_MALLOC=y
CONFIG_HAS_CUSTOM_SPL_MALLOC_START=y
CONFIG_CUSTOM_SYS_SPL_MALLOC_ADDR=0x24000000
CONFIG_SYS_SPL_MALLOC_SIZE=0x400000
CONFIG_SPL_OPENSBI_SCRATCH_OPTIONS=0x0
CONFIG_HUSH_PARSER=y
CONFIG_SYS_CBSIZE=256
CONFIG_SYS_PBSIZE=276
# CONFIG_CMD_CPU is not set
CONFIG_SYS_BOOTM_LEN=0xa000000
CONFIG_CMD_PART=y
# CONFIG_CMD_SCSI is not set
CONFIG_CMD_DHCP=y
CONFIG_SYS_DISABLE_AUTOLOAD=y
CONFIG_CMD_PXE=y
CONFIG_CMD_SYSBOOT=y
# CONFIG_OF_OMIT_DTB is not set
CONFIG_PROT_UDP=y
CONFIG_NET_RANDOM_ETHADDR=y
CONFIG_IP_DEFRAG=y
CONFIG_KEEP_SERVERADDR=y
CONFIG_BOOTP_SERVERIP=y
CONFIG_DEVRES=y
# CONFIG_SCSI_AHCI is not set
# CONFIG_CLK is not set
CONFIG_DMA=y
CONFIG_DMA_CHANNELS=y
# CONFIG_GPIO is not set
# CONFIG_I2C is not set
# CONFIG_INPUT is not set
CONFIG_MISC=y
# CONFIG_DM_MMC is not set
# CONFIG_MTD is not set
# CONFIG_MTD_NOR_FLASH is not set
CONFIG_SPACEMIT_K1X_EMAC=y
# CONFIG_PCI is not set
# CONFIG_SCSI is not set
# CONFIG_DM_SCSI is not set
CONFIG_SYS_NS16550_IER=0x40
# CONFIG_HTIF_CONSOLE is not set
# CONFIG_SIFIVE_SERIAL is not set
CONFIG_TIMER_EARLY=y
```

## configs/k2_defconfig
```kconfig
CONFIG_RISCV=y
CONFIG_SYS_TEXT_BASE=0xa000200000
CONFIG_SYS_MALLOC_LEN=0x800000
CONFIG_SYS_MALLOC_F_LEN=0x2000
CONFIG_NR_DRAM_BANKS=1
CONFIG_ENV_SIZE=0x20000
CONFIG_DEFAULT_DEVICE_TREE="k2_fpga"
CONFIG_SPL_TEXT_BASE=0xC0800000
CONFIG_SPL_SIZE_LIMIT=0x20000
CONFIG_SPL=y
CONFIG_SYS_LOAD_ADDR=0x0
CONFIG_BUILD_TARGET=""
CONFIG_TARGET_SPACEMIT_K2=y
CONFIG_ARCH_RV64I=y
CONFIG_RISCV_SMODE=y
CONFIG_LOCALVERSION="spacemit"
CONFIG_HAS_CUSTOM_SYS_INIT_SP_ADDR=y
CONFIG_CUSTOM_SYS_INIT_SP_ADDR=0x2f940000
CONFIG_ANDROID_BOOT_IMAGE=y
CONFIG_FIT=y
# CONFIG_BOOTSTD_BOOTCOMMAND is not set
CONFIG_SUPPORT_RAW_INITRD=y
CONFIG_BOOTDELAY=0
CONFIG_AUTOBOOT_KEYED=y
CONFIG_AUTOBOOT_STOP_STR="s"
CONFIG_USE_BOOTCOMMAND=y
CONFIG_BOOTCOMMAND="dhcp"
CONFIG_DISPLAY_CPUINFO=y
CONFIG_DISPLAY_BOARDINFO=y
CONFIG_BOARD_LATE_INIT=y
CONFIG_SPL_MAX_SIZE=0x20000
CONFIG_SPL_BSS_START_ADDR=0xC0820000
CONFIG_SPL_BSS_MAX_SIZE=0x20000
CONFIG_SPL_RAM_SUPPORT=y
CONFIG_SPL_RAM_DEVICE=y
CONFIG_HUSH_PARSER=y
CONFIG_SYS_CBSIZE=256
CONFIG_SYS_PBSIZE=276
# CONFIG_CMD_CPU is not set
CONFIG_CMD_SBI=y
CONFIG_SYS_BOOTM_LEN=0xa000000
# CONFIG_CMD_NVME is not set
CONFIG_CMD_PART=y
CONFIG_CMD_POWEROFF=y
CONFIG_CMD_DHCP=y
CONFIG_SYS_DISABLE_AUTOLOAD=y
CONFIG_CMD_PING=y
CONFIG_CMD_PXE=y
CONFIG_CMD_SYSBOOT=y
CONFIG_CMD_EXT2=y
CONFIG_CMD_EXT4=y
CONFIG_CMD_FAT=y
CONFIG_CMD_FS_GENERIC=y
CONFIG_ISO_PARTITION=y
CONFIG_EFI_PARTITION=y
CONFIG_OF_BOARD=y
CONFIG_PROT_UDP=y
CONFIG_NET_RANDOM_ETHADDR=y
CONFIG_IP_DEFRAG=y
CONFIG_KEEP_SERVERADDR=y
CONFIG_BOOTP_SERVERIP=y
CONFIG_DEVRES=y
CONFIG_CLK_CCF=y
CONFIG_DMA=y
CONFIG_DMA_CHANNELS=y
# CONFIG_GPIO is not set
# CONFIG_I2C is not set
# CONFIG_INPUT is not set
CONFIG_MISC=y
# CONFIG_DM_MMC is not set
# CONFIG_MTD is not set
CONFIG_PHYLIB=y
CONFIG_NVME=y
CONFIG_SYS_NS16550=y
CONFIG_HTIF_CONSOLE=y
CONFIG_SIFIVE_SERIAL=y
CONFIG_SYSRESET=y
CONFIG_SYSRESET_SYSCON=y
CONFIG_TIMER_EARLY=y
CONFIG_VIRTIO_MMIO=y
CONFIG_VIRTIO_NET=y
CONFIG_VIRTIO_BLK=y
```
