## configs/k3_defconfig
```kconfig
CONFIG_RISCV=y
CONFIG_SYS_TEXT_BASE=0x102000000
CONFIG_SYS_MALLOC_LEN=0x800000
CONFIG_NR_DRAM_BANKS=1
CONFIG_ENV_SIZE=0x20000
CONFIG_DM_GPIO=y
CONFIG_SPL_DM_SPI=y
CONFIG_DEFAULT_DEVICE_TREE="k3_fpga_1x1"
CONFIG_SPL_TEXT_BASE=0xc0800000
CONFIG_SPL_SIZE_LIMIT=0x30000
CONFIG_SPL=y
CONFIG_SPL_SPI_FLASH_SUPPORT=y
CONFIG_SPL_SPI=y
CONFIG_SYS_LOAD_ADDR=0x102000000
CONFIG_TARGET_SPACEMIT_K3=y
CONFIG_SPL_OPENSBI_LOAD_ADDR=0x100000000
CONFIG_ARCH_RV64I=y
CONFIG_RISCV_SMODE=y
# CONFIG_RISCV_ISA_C is not set
# CONFIG_SPL_SMP is not set
CONFIG_ENV_VARS_UBOOT_CONFIG=y
CONFIG_HAS_CUSTOM_SYS_INIT_SP_ADDR=y
CONFIG_CUSTOM_SYS_INIT_SP_ADDR=0x102300000
CONFIG_STACK_SIZE=0x100000
# CONFIG_ANDROID_BOOT_IMAGE is not set
CONFIG_FIT=y
# CONFIG_FIT_FULL_CHECK is not set
CONFIG_SPL_LOAD_FIT_ADDRESS=0x102000000
CONFIG_SPL_FIT_IMAGE_POST_PROCESS=y
# CONFIG_BOOTSTD is not set
# CONFIG_LEGACY_IMAGE_FORMAT is not set
CONFIG_SUPPORT_RAW_INITRD=y
CONFIG_BOOTDELAY=3
CONFIG_USE_BOOTCOMMAND=y
CONFIG_BOOTCOMMAND="booti 0x110000000 - 0x128000000"
CONFIG_LOGLEVEL=7
CONFIG_LOG=y
CONFIG_LOG_MAX_LEVEL=8
CONFIG_LOG_DEFAULT_LEVEL=6
CONFIG_LOGF_FILE=y
CONFIG_LOGF_LINE=y
CONFIG_LOGF_FUNC=y
CONFIG_SPL_LOG=y
CONFIG_SPL_LOG_MAX_LEVEL=6
CONFIG_LOG_ERROR_RETURN=y
CONFIG_DISPLAY_CPUINFO=y
CONFIG_DISPLAY_BOARDINFO=y
CONFIG_EVENT=y
CONFIG_EVENT_DYNAMIC=y
CONFIG_MISC_INIT_R=y
CONFIG_SPL_MAX_SIZE=0x50000
CONFIG_SPL_PAD_TO=0x0
CONFIG_SPL_BSS_START_ADDR=0xc0830000
CONFIG_SPL_BSS_MAX_SIZE=0x8000
# CONFIG_SPL_SHARES_INIT_SP_ADDR is not set
CONFIG_SPL_STACK=0xc0840000
CONFIG_SYS_SPL_MALLOC=y
CONFIG_HAS_CUSTOM_SPL_MALLOC_START=y
CONFIG_CUSTOM_SYS_SPL_MALLOC_ADDR=0x104000000
CONFIG_SYS_SPL_MALLOC_SIZE=0x2000000
CONFIG_SYS_MMCSD_RAW_MODE_U_BOOT_USE_PARTITION=y
CONFIG_SPL_ENV_SUPPORT=y
CONFIG_SPL_MTD_SUPPORT=y
CONFIG_SPL_DM_SPI_FLASH=y
CONFIG_SPL_DM_RESET=y
CONFIG_SPL_RAM_SUPPORT=y
CONFIG_SPL_RAM_DEVICE=y
CONFIG_SPL_SPI_FLASH_MTD=y
CONFIG_SPL_MTD_LOAD=y
CONFIG_SYS_LOAD_IMAGE_PARTITION_NAME="opensbi"
CONFIG_SPL_WATCHDOG=y
CONFIG_SPL_OPENSBI_SCRATCH_OPTIONS=0x0
CONFIG_HUSH_PARSER=y
CONFIG_SYS_CBSIZE=256
CONFIG_SYS_PBSIZE=276
# CONFIG_CMD_BDI is not set
# CONFIG_BOOTM_NETBSD is not set
# CONFIG_BOOTM_PLAN9 is not set
# CONFIG_BOOTM_RTEMS is not set
# CONFIG_BOOTM_VXWORKS is not set
CONFIG_SYS_BOOTM_LEN=0x4000000
# CONFIG_CMD_ELF is not set
CONFIG_CMD_MD5SUM=y
# CONFIG_CMD_LZMADEC is not set
# CONFIG_CMD_UNLZ4 is not set
CONFIG_CMD_GPIO=y
CONFIG_CMD_GPT=y
CONFIG_CMD_GPT_RENAME=y
CONFIG_CMD_I2C=y
CONFIG_CMD_MMC=y
CONFIG_CMD_BKOPS_ENABLE=y
CONFIG_CMD_MTD=y
CONFIG_CMD_PART=y
CONFIG_CMD_PCI=y
CONFIG_CMD_DHCP=y
CONFIG_CMD_TFTPPUT=y
CONFIG_SYS_DISABLE_AUTOLOAD=y
CONFIG_CMD_PING=y
# CONFIG_CMD_BLOCK_CACHE is not set
CONFIG_CMD_SYSBOOT=y
CONFIG_CMD_FAT=y
CONFIG_CMD_FS_GENERIC=y
CONFIG_CMD_MTDPARTS=y
CONFIG_MTDIDS_DEFAULT="nor0=spi-flash"
CONFIG_MTDPARTS_DEFAULT="spi-flash:128K@0(bootinfo),256K@128K(fsbl),64K@384K(env),1M@448K(esos),384K@1472K(opensbi),-@1856K(uboot)"
# CONFIG_DOS_PARTITION is not set
CONFIG_PARTITION_TYPE_GUID=y
CONFIG_SYS_RELOC_GD_ENV_ADDR=y
CONFIG_ARP_TIMEOUT=500
CONFIG_NET_RETRY_COUNT=50
CONFIG_NET_RANDOM_ETHADDR=y
CONFIG_IP_DEFRAG=y
CONFIG_NET_MAXDEFRAG=65535
CONFIG_USB_FUNCTION_FASTBOOT=y
CONFIG_FASTBOOT_BUF_ADDR=0x150000000
CONFIG_FASTBOOT_BUF_SIZE=0x10000000
CONFIG_K1X_GPIO=y
CONFIG_DM_I2C=y
CONFIG_I2C_SET_DEFAULT_BUS_NUM=y
# CONFIG_INPUT is not set
CONFIG_MISC=y
CONFIG_MMC=y
CONFIG_SUPPORT_EMMC_BOOT=y
CONFIG_MMC_IO_VOLTAGE=y
CONFIG_MMC_UHS_SUPPORT=y
CONFIG_MMC_HS400_ES_SUPPORT=y
CONFIG_MMC_HS400_SUPPORT=y
# CONFIG_MMC_VERBOSE is not set
CONFIG_MMC_SDHCI=y
CONFIG_MMC_SDHCI_ADMA=y
CONFIG_MMC_SDHCI_K1X=y
CONFIG_DM_MTD=y
CONFIG_SPI_FLASH_GIGADEVICE=y
CONFIG_SPI_FLASH_WINBOND=y
CONFIG_SPI_FLASH_XMC=y
CONFIG_SPI_FLASH_MTD=y
CONFIG_DWC_ETH_QOS=y
CONFIG_DWC_ETH_QOS_K3=y
CONFIG_PINCTRL=y
# CONFIG_POWER is not set
# CONFIG_RAM_SIFIVE is not set
CONFIG_SPL_REMOTEPROC_K3_PROC=y
CONFIG_RESET_SPACEMIT_K3=y
CONFIG_SYS_NS16550=y
CONFIG_SYS_NS16550_IER=0x40
CONFIG_SPI=y
CONFIG_K1X_QSPI=y
CONFIG_TIMER_EARLY=y
CONFIG_USB=y
CONFIG_DM_USB_GADGET=y
CONFIG_USB_DWC3=y
CONFIG_USB_DWC3_GENERIC=y
CONFIG_USB_GADGET=y
CONFIG_USB_GADGET_VENDOR_NUM=0x361c
CONFIG_USB_GADGET_PRODUCT_NUM=0x1001
CONFIG_WDT=y
# CONFIG_REGEX is not set
# CONFIG_SPL_SHA1 is not set
# CONFIG_SPL_SHA256 is not set
# CONFIG_EFI_LOADER is not set
```

## drivers/clk/spacemit/Kconfig
```kconfig
# SPDX-License-Identifier: GPL-2.0
# common clock support for SPACEMIT SoC family.

config CLK_K1_CCU
	tristate "Spacemit K1pro clock controller support"
	depends on CLK
        depends on CLK_CCF
	help
	  Build the driver for K1pro Clock Driver.

config SPACEMIT_K1X_CCU
        tristate "Clock support for Spacemit k1x SoCs"
        select CLK
        select CLK_CCF
        help
          Build the driver for Spacemit K1x Clock Driver.
```

## drivers/ddr/spacemit/k3/Kconfig
```kconfig
# SPDX-License-Identifier: GPL-2.0+
#
# Copyright (C) 2026 Spacemit

menu "Spacemit K3 DDR controllers"
	depends on TARGET_SPACEMIT_K3 && K3_BOARD_ASIC

config K3_DDR_LPDDR5
	bool "k3 lpddr5"
	default y
	help
	  Select the K3 LPDDR5 driver support. Disabling this removes the
	  LPDDR5 init, pre-training and quickboot tables from SPL.

	  The DDR part is picked at runtime from the part number in TLV,
	  so disable this only on boards that never carry an LPDDR5 part.

config K3_DDR_LPDDR4X
	bool "k3 lpddr4x"
	default y
	help
	  Select the K3 LPDDR4X driver support. Disabling this removes the
	  LPDDR4X init, pre-training and quickboot tables from SPL.

	  The DDR part is picked at runtime from the part number in TLV,
	  so disable this only on boards that never carry an LPDDR4X part.

endmenu
```

## drivers/phy/spacemit/Kconfig
```kconfig
config PHY_SPACEMIT_K1X_USB2
	bool "Spacemit k1-x USB2 PHY Driver"
	depends on PHY
	help
	  Support for Spacemit k1-x USB 2 PHY
```

## drivers/usb/tcpm/Kconfig
```kconfig
# SPDX-License-Identifier: GPL-2.0

config TYPEC_TCPM
	tristate "USB Type-C Port Controller Manager"
	depends on DM
	help
	  The Type-C Port Controller Manager provides a USB PD and USB Type-C
	  state machine for use with Type-C Port Controllers.

config TYPEC_FUSB301
	tristate "Fairchild FUSB301 Type-C chip driver"
	depends on DM && DM_I2C && TYPEC_TCPM
	help
	  The Fairchild FUSB301 Type-C chip driver that works with
	  Type-C Port Controller Manager to provide USB Type-C functionalities.
```

## drivers/video/spacemit/Kconfig
```kconfig
# SPDX-License-Identifier: GPL-2.0

menuconfig VIDEO_SPACEMIT
	bool "Enable SPACEMIT Video Support"
	depends on DM_VIDEO
	help
	  SPACEMIT SoCs provide video output capabilities for High-Definition
	  Multimedia Interface (HDMI) and Display Serial Interface (DSI).

	  This driver supports the on-chip video output device.

config VIDEO_SPACEMIT_MAX_XRES
        int "Maximum horizontal resolution (for memory allocation purposes)"
	depends on VIDEO_SPACEMIT
	default 1920 if DISPLAY_SPACEMIT_HDMI
	default 1920
	help
	  The maximum horizontal resolution to support for the framebuffer.
	  This configuration is used for reserving/allocating memory for the
	  framebuffer during device-model binding/probing.

config VIDEO_SPACEMIT_MAX_YRES
        int "Maximum vertical resolution (for memory allocation purposes)"
	depends on VIDEO_SPACEMIT
	default 1080 if DISPLAY_SPACEMIT_HDMI
	default 1080
	help
	  The maximum vertical resolution to support for the framebuffer.
	  This configuration is used for reserving/allocating memory for the
	  framebuffer during device-model binding/probing.

if VIDEO_SPACEMIT

config DISPLAY_SPACEMIT_HDMI
	bool "HDMI port"
	depends on VIDEO_SPACEMIT
	help
	  This enables High-Definition Multimedia Interface display support.

endif
```

## drivers/video/spacemit/dsi/Kconfig
```kconfig
# SPDX-License-Identifier: GPL-2.0

config DISPLAY_SPACEMIT_MULTIPLE_MIPI_PANELS
	bool "Support Multiple MIPI DSI Panels"
	depends on DISPLAY_SPACEMIT_MIPI
	help
	  This enables multiple different MIPI DSI panels support.

config LCD_LT8911_EDP_1920X1080
	bool "Add lcd lt8911 edp 1920x1080 panel"
	depends on DISPLAY_SPACEMIT_MULTIPLE_MIPI_PANELS
	help
	  support lcd_lt8911_edp_1920x1080 panel

config LCD_TC358762XBG_DPI_800X480
	bool "Add lcd tc358762xbg dpi 800x480 panel"
	depends on DISPLAY_SPACEMIT_MULTIPLE_MIPI_PANELS
	help
	  support lcd_tc358762xbg_dpi_800x480 panel

config LCD_ICNL9951R_MIPI
	bool "Add lcd icnl9951r mipi panel"
	depends on DISPLAY_SPACEMIT_MULTIPLE_MIPI_PANELS
	help
	  support lcd_icnl9951r_mipi panel

config LCD_ICNL9911C_MIPI
	bool "Add lcd icnl9911c mipi panel"
	depends on DISPLAY_SPACEMIT_MULTIPLE_MIPI_PANELS
	help
	  support lcd_icnl9911c_mipi panel

config LCD_JD9365DAH3_MIPI
	bool "Add lcd jd9365dah3 mipi panel"
	depends on DISPLAY_SPACEMIT_MULTIPLE_MIPI_PANELS
	help
	  support lcd_jd9365dah3_mipi panel

config LCD_JD9366TC_MIPI
	bool "Add lcd jd9366tc mipi panel"
	depends on DISPLAY_SPACEMIT_MULTIPLE_MIPI_PANELS
	help
	  support lcd_jd9366tc_mipi panel

config LCD_FT8201SINX101_MIPI
	bool "Add lcd ft8201sinx101 mipi panel"
	depends on DISPLAY_SPACEMIT_MULTIPLE_MIPI_PANELS
	help
	  support lcd_ft8201sinx101_mipi panel

config LCD_HXDM101_MIPI
	bool "Add lcd hxdm101 mipi panel"
	depends on DISPLAY_SPACEMIT_MULTIPLE_MIPI_PANELS
	help
	  support lcd_hxdm101_mipi panel

config LCD_CO5300_MIPI
	bool "Add lcd co5300 mipi panel"
	depends on DISPLAY_SPACEMIT_MULTIPLE_MIPI_PANELS
	help
	  support lcd_co5300_mipi panel

config LCD_GX09INX101_MIPI
	bool "Add lcd gx09inx101 mipi panel"
	depends on DISPLAY_SPACEMIT_MULTIPLE_MIPI_PANELS
	help
	  support lcd_gx09inx101_mipi panel
```
