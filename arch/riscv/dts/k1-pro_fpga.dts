// SPDX-License-Identifier: (GPL-2.0 OR MIT)
/* Copyright (c) 2022 Spacemit, Inc */

/dts-v1/;

#include "k1-pro.dtsi"
/ {
	model = "spacemit k1-pro fpga board";

	memory@0 {
		device_type = "memory";
		reg = <0x0 0x40000000 0x0 0x10000000>;
	};

	chosen {
		stdout-path = &uart0;
	};
};

&uart0 {
	status = "okay";
};
